/dts-v1/;

#include "pxa27x.dtsi"

/ {
	model = "Gumstix Verdex Platform";
	compatible = "gumstix,verdex", "marvell,pxa270";

	memory {
		reg = <0xA0000000 0x10000000>;
	};

	pxabus {
		ffuart: uart@40100000 {
			status = "okay";
		};
	};
};
