/dts-v1/;

/ {
    a {
        x = <10>;
	y = <20>;
                
	b {
            z = <30>;
	    phandle = <1>;
        };            
    };

    c  {
        path = <1>;
    };                
};
